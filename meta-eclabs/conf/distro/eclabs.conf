## meta-eclabs/conf/distro/eclabs.conf
```bitbake
MAINTAINER = "eclabs eclabs007@gmail.com"
require conf/distro/poky.conf
DISTRO = "eclabs"
DISTRO_NAME = "eclabs"
DISTRO_VERSION = "1.0"
DISTRO_CODENAME = "eclabs"

#DISTRO_FEATURES_remove += " sysvinit bluetooth pcmcia wayland bluez5 pci ext2 irda x11 nfc ptest 3g"
DISTRO_FEATURES_remove += " sysvinit  ptest 3g"
DISTRO_FEATURES_append = " systemd wifi opengl pam pulseaudio egl alsa-plugins"
VIRTUAL-RUNTIME_init_manager = "systemd"
VIRTUAL-RUNTIME_initscripts = "systemd-compat-units"
DISTRO_FEATURES_BACKFILL_CONSIDERED += "sysvinit"
hostname_pn-base-files = "eclabs"
# Set locale
GLIBC_GENERATE_LOCALES = "en_GB.UTF-8 en_US.UTF-8"
IMAGE_LINGUAS = "en-gb en-us"

# Set default timezone
DEFAULT_TIMEZONE = "Europe/London"

# Whitelist commercial license. This is needed because of omxplayer and possible others.
LICENSE_FLAGS_WHITELIST = "commercial"
```

## meta-eclabs/conf/layer.conf
```bitbake
# We have a conf and classes directory, add to BBPATH
BBPATH .= ":${LAYERDIR}"

# We have recipes-* directories, add to BBFILES
BBFILES += "${LAYERDIR}/recipes-*/*/*.bb \
            ${LAYERDIR}/recipes-*/*/*.bbappend"

BBFILE_COLLECTIONS += "meta-eclabs"
BBFILE_PATTERN_meta-eclabs = "^${LAYERDIR}/"
BBFILE_PRIORITY_meta-eclabs = "6"

LAYERDEPENDS_meta-eclabs = "core"
LAYERSERIES_COMPAT_meta-eclabs = "warrior zeus"
```
